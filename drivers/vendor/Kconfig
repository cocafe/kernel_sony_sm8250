## drivers/vendor/qcom/Kconfig
```kconfig
config QCOM_VENDOR_AUDIO
	tristate "Qualcomm audio kernel modules"
	default m

source "drivers/vendor/qcom/data-kernel/drivers/rmnet/perf/Kconfig"
source "drivers/vendor/qcom/data-kernel/drivers/rmnet/shs/Kconfig"
```

## drivers/vendor/semc/Kconfig
```kconfig
config SEC_TOUCHSCREEN
	tristate "Sony Touchscreen"
	default m

config SEMC_LAST_LOGS
	tristate "Sony Last Logs"
	default m

config SEMC_POWERKEY_CRASH
	tristate "Sony PowerKey Crash"
	default m

config SEMC_BU520X1NVX
	tristate "bu520x1nvx bipolar detection device"
	default m

config SEMC_CAMERA_MODULES
	tristate "sony camera modules"
	default m

config SEMC_FINGERPRINT_DRIVER
	tristate "sony fingerprint driver"
	default m

config NXP_PN553
	tristate "NXP PN553 NFC"
	default m
```
